## nrf9160/build/Kconfig/Kconfig.modules
```kconfig
osource "/home/kantum/depots/ncs/nrf/Kconfig.nrf"

osource "/home/kantum/depots/ncs/bootloader/mcuboot/zephyr/Kconfig"

osource "/home/kantum/depots/ncs/nrfxlib/Kconfig.nrfxlib"
```

## nrf9160/build/Kconfig/Kconfig.soc
```kconfig
osource "/home/kantum/depots/ncs/zephyr/soc/$(ARCH)/*/Kconfig.soc"
osource "/home/kantum/depots/ncs/zephyr/soc/$(ARCH)/*/Kconfig.soc"
```

## nrf9160/build/Kconfig/Kconfig.soc.arch
```kconfig
osource "/home/kantum/depots/ncs/zephyr/soc/$(ARCH)/Kconfig"
osource "/home/kantum/depots/ncs/zephyr/soc/$(ARCH)/*/Kconfig"
osource "/home/kantum/depots/ncs/zephyr/soc/$(ARCH)/Kconfig"
osource "/home/kantum/depots/ncs/zephyr/soc/$(ARCH)/*/Kconfig"
```

## nrf9160/build/Kconfig/Kconfig.soc.defconfig
```kconfig
osource "/home/kantum/depots/ncs/zephyr/soc/$(ARCH)/*/Kconfig.defconfig"
osource "/home/kantum/depots/ncs/zephyr/soc/$(ARCH)/*/Kconfig.defconfig"
```
